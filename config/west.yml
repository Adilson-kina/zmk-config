## config/west.yml
```yaml
manifest:
  remotes:
    - name: zmkfirmware
      url-base: https://github.com/zmkfirmware
    - name: mctechnology17
      url-base: https://github.com/mctechnology17
  projects:
    - name: zmk
      remote: zmkfirmware
      revision: v0.3.0 # Pinned to a stable version for compatibility
      import: app/west.yml
    - name: zmk-nice-oled
      remote: mctechnology17
      revision: main
  self:
    path: config
```
